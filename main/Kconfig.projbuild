## main/Kconfig.projbuild
```kconfig
# put here your custom config value
menu "ESP32-CAM Example Configuration"
choice ESP32CAM_WIFI_CONFIG
        prompt "How do you want to configure Wifi?"

    config ESPCAM_WIFI_CRED_STATIC
        bool "Use the credentials supplied below"
        help
            Use static credentials configured at compile time

    config ESPCAM_WIFI_CRED_SMARTCONFIG
        bool "Use espressif smartconfig"
        help
            Use the smart config app to set wifi credentials

endchoice

config ESPCAM_WIFI_SSID
    string "WiFi SSID"
    default "myssid"
    depends on ESPCAM_WIFI_CRED_STATIC
    help
	SSID (network name) for the example to connect to.

config ESPCAM_WIFI_PASSWORD
    string "WiFi Password"
    default "mypassword"
    depends on ESPCAM_WIFI_CRED_STATIC
    help
	WiFi password (WPA or WPA2) for the example to use.

endmenu
```

## sdkconfig.defaults
```kconfig
# Add any default sdkconfig settings here

# ESP32-CAM units have a SPIRAM chip, required for the camera component
CONFIG_ESP32_SPIRAM_SUPPORT=y

# ESP32-CAM units have 4Mb flash
CONFIG_ESPTOOLPY_FLASHSIZE_4MB=y
CONFIG_ESPTOOLPY_FLASHSIZE="4MB"
```
